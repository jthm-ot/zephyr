## tests/bluetooth/shell/boards/nrf5340_audio_dk_nrf5340_cpuapp.conf
```kconfig
# For LC3 the following configs are needed
CONFIG_FPU=y
CONFIG_LIBLC3=y
# The LC3 codec uses a large amount of stack. This app runs the codec in the work-queue, hence
# inctease stack size for that thread.
CONFIG_SYSTEM_WORKQUEUE_STACK_SIZE=4096

CONFIG_BT_TINYCRYPT_ECC=y
CONFIG_BT_LOG_SNIFFER_INFO=y
CONFIG_BT_SMP_LOG_LEVEL_INF=y
```
